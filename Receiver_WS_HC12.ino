#include "SPI.h"
#include "Adafruit_GFX.h"
#include "Adafruit_ILI9341.h"
#include <Fonts/Dialogp.h>            //plain
#include <Fonts/Dialogb.h>            //bold
#include <Arduino.h>
#include <FlickerFreePrint.h>
#include <SoftwareSerial.h>
//#include <Adafruit_NeoPixel.h>
#ifdef __AVR__
 #include <avr/power.h> // Required for 16 MHz Adafruit Trinket
#endif

// Which pin on the Arduino is connected to the NeoPixels?
#define PIN        5 // On Trinket or Gemma, suggest changing this to 1

// How many NeoPixels are attached to the Arduino?
//#define NUMPIXELS 16 // Popular NeoPixel ring size



// For the Adafruit shield, these are the default.
#define TFT_DC 10
#define TFT_CS 8
#define TFT_RST 9


#define BLACK    0x0000
#define BLUE     0x0C3A
#define RED      0xF800
#define GREEN    0x35a5
#define CYAN     0x07FF
#define MAGENTA  0xF81F
#define YELLOW   0xF640 
#define WHITE    0xFFFF
#define GREY     0xD6BA
#define WHITEx   0xdf1d
#define blue     0x51dc
#define giallo   0xb5a5

//Adafruit_NeoPixel pixels(NUMPIXELS, PIN, NEO_GRB + NEO_KHZ800);


// Use hardware SPI (on Uno, #13, #12, #11) and the above for CS/DC
//Adafruit_ILI9341 tft = Adafruit_ILI9341(TFT_CS, TFT_DC);
// If using the breakout, change pins as desired
Adafruit_ILI9341 tft = Adafruit_ILI9341(TFT_CS, TFT_DC, TFT_RST);
const unsigned char cloud[] PROGMEM= {0x0,0x0,0x0,0x0,0x0,0x0,0x0,0x0,0x0,0x0,0x0,0x0,0x0,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0x0,0x0};
const unsigned char thunder[] PROGMEM={0x0,0x0,0x0,0x0,0x0,0x0,0x0,0x0,0x0,0x0,0x0,0x0,0x0,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0x0,0x0};
const unsigned char wind[] PROGMEM= {0x0,0x0,0x0,0x0,0x0,0x0,0x0,0x0,0x0,0x0,0x0,0x0,0x0,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0x0,0x0};

/*
  const uint32_t viola1 = pixels.Color(100, 0, 150);
  const uint32_t viola2 = pixels.Color(80, 0, 200);
  const uint32_t viola3 = pixels.Color(60, 0, 200);
  const uint32_t viola4 = pixels.Color(20, 0, 200);
  const uint32_t blu1 = pixels.Color(0, 0, 255);
  const uint32_t blu2 = pixels.Color(0, 80, 200);
  const uint32_t blu3 = pixels.Color(0, 150, 150);
  const uint32_t blu4 = pixels.Color(0, 180, 50);
  const uint32_t giallo1 = pixels.Color(0, 220, 50);
  const uint32_t giallo2 = pixels.Color(70, 220, 0);
  const uint32_t giallo3 = pixels.Color(150, 150, 0);
  const uint32_t giallo4 = pixels.Color(200, 170, 0);
  const uint32_t rosso1 = pixels.Color(250, 170, 0);
  const uint32_t rosso2 = pixels.Color(200, 100, 0);
  const uint32_t rosso3 = pixels.Color(200, 50, 0);
  const uint32_t rosso4 = pixels.Color(200, 0, 0);
  const uint32_t black = pixels.Color(0, 0, 0);
*/
  
  float temperature = 0.0;
  float humidity = 0.0;
  float pioggia = 0.0;
  int co = 0;
  String a;
  float t,h,p,c;

  int x=0;
  char state='s';
  char old='s';
  
  char nuovo='a';
  char vecchio='a';
  
  SoftwareSerial HC(2,3); //rx,tx

  FlickerFreePrint<Adafruit_ILI9341> Data1(&tft, WHITEx, BLACK);
  FlickerFreePrint<Adafruit_ILI9341> Data2(&tft, WHITEx, BLACK);
  FlickerFreePrint<Adafruit_ILI9341> Data3(&tft, WHITEx, BLACK);
  
void setup() {
  Serial.begin(9600);
  #if defined(__AVR_ATtiny85__) && (F_CPU == 16000000)
  clock_prescale_set(clock_div_1);
  #endif
  
  HC.begin(9600);
//  pixels.begin(); // INITIALIZE NeoPixel strip object (REQUIRED)
//  pixels.setBrightness(30); // da 0 a 255
  
  tft.begin();
  tft.setRotation(3);
  tft.fillScreen(BLACK);

  tft.setFont(&Dialog_plain_25);
  tft.setCursor(0,30);
  tft.setTextColor(giallo);
  tft.print("TEMPERATURA:");

  tft.setFont(&Dialog_plain_25);
  tft.setCursor(0,65);
  tft.setTextColor(CYAN);
  tft.print("UMIDITA':");
  
  tft.setFont(&Dialog_plain_25);
  tft.setCursor(0,100);
  tft.setTextColor(CYAN);
  tft.print("PIOGGE:");
  
  tft.setFont(&Dialog_plain_25);
  tft.setCursor(0,140);
  tft.setTextColor(GREY);
  tft.print("PRESSIONE:");

  tft.setFont(&Dialog_bold_25);
  tft.setCursor(217,65);
  tft.setTextColor(CYAN);
  tft.print("%");
  
  tft.setFont(&Dialog_bold_25);
  tft.setCursor(290,30);
  tft.setTextColor(giallo);
  tft.print("°C");

  tft.setFont(&Dialog_bold_25);
  tft.setCursor(245,140);
  tft.setTextColor(GREY);
  tft.print("hPa");

//  tft.setCursor(130,100);
//  tft.setTextColor(GREEN);
//  tft.print(a);
  
  //  ??? drawTheSun();
    
    
}

void loop(){
      
      delay(500);
      if(HC.available()>3){
      //x+=1;
      t=HC.parseFloat();
      h=HC.parseFloat();
      p=HC.parseFloat();
      c=HC.parseFloat();
      HC.flush();
     

    control();   

   // Serial.println(p);
    tft.setFont(&Dialog_bold_25);
    
    if(pioggia>=800){
      vecchio=nuovo;
      nuovo='l';
     
     }
     else if(pioggia<800 && pioggia>=700){
      vecchio=nuovo;
      nuovo='d';      
    
     }
     else if(pioggia<700 && pioggia>=600){
      vecchio=nuovo;
      nuovo='m';      
    
     }
     else if(pioggia<600 && pioggia>=480){
      vecchio=nuovo;
      nuovo='b';      
    
     }
     else if(pioggia<480 && pioggia>=420){
      vecchio=nuovo;
      nuovo='f';      
    
     }
     else if(pioggia<420 && pioggia>=0){
      vecchio=nuovo;
      nuovo='n';      
    
     }

     if(nuovo==vecchio){
  
     }else{

      if(nuovo=='l'){
        clearText();
        a="Assenti                           ";
      }else if(nuovo=='d'){
       clearText();
        a="Deboli                              ";
      }else if(nuovo=='m'){
        clearText();
        a="Moderate                               "; 
      }else if(nuovo=='b'){
        clearText();
        a="Abbondanti                                ";
      }else if(nuovo=='f'){
        clearText();
        a="Forti                                 ";
      }else if(nuovo=='n'){
        clearText();
        a="Nubifragio                            ";
      }
    
   }

  
  tft.setCursor(130,100);
  tft.setTextColor(GREEN);
  tft.print(a);

  
  tft.setCursor(170,140);
  Data3.setTextColor(WHITEx, BLACK);
  Data3.print(co);   

  tft.setCursor(210,30);
  Data2.setTextColor(WHITEx, BLACK);
  Data2.print(temperature,1); 

  tft.setCursor(135,65);
  Data1.setTextColor(WHITEx, BLACK);
  Data1.print(humidity,1);
  


  if(co>=990 && co<1018 && pioggia>=800){       //sole-nuvola         <--- QUI VA MESSO LA PRESSIONE NON PIOGGIA==300 (USATA SOLO PER TESTARE)  co sarebbe la pressione
   // tft.fillRect(60,160,200,80,BLACK);
    //drawCloud();
    old=state;
    state='n';
  }else if(co>=1018 && pioggia>=800){        //sole
    //tft.fillRect(60,160,200,80,BLACK);
    //drawTheSun();
    old=state;
    state='v';
  }else if(pioggia<=800 && pioggia>600){  //pioggia debole
     old=state;
     state='p';
  }else if(pioggia<=600 && pioggia>480){ //pioggia moderata
     old=state;
     state='q';
  }else if(pioggia<=480 && co>988){ //pioggia forte
     old=state;
     state='h';
  }else if(pioggia<=480 && co<=988){ //temporale
     old=state;
     state='z';
  }

  if(state==old){
    
  }else{
    if(state=='v'){
        clearIco();       
        drawTheSun();
        //old='s';
    }else if (state=='n'){
        clearIco();
        drawCloudWithSun();
       //old='n';
    }else if(state=='p'){
        clearIco();
        drawLightRain();
    }else if(state=='q'){
        clearIco();
        drawModerateRain();
    }else if(state=='h'){
        clearIco();
        drawHeavyRain();
    }else if(state=='z'){
        clearIco();
        drawThunderstorm();
    }
 
  }
 }
}



void drawTheSun()
{
    tft.fillCircle(155,195,26,YELLOW);
}

void drawTheFullMoon()
{
    tft.fillCircle(64,80,26,GREY);
}

void drawTheMoon()
{
    tft.fillCircle(64,80,26,GREY);
    tft.fillCircle(75,73,26,BLACK);
}

void drawCloud()
{
     tft.drawBitmap(95,140,cloud,128,90,GREY);
}

void drawCloudWithSun()
{
     tft.fillCircle(155,193,27,YELLOW);
     tft.drawBitmap(90,151,cloud,128,90,BLACK);
     tft.drawBitmap(90,155,cloud,128,90,GREY);
}

void drawLightRain()
{
     tft.drawBitmap(95,140,cloud,128,90,GREY);//0  35
     tft.fillRoundRect(145, 210, 3, 13, 1, BLUE);
     tft.fillRoundRect(160, 210, 3, 13, 1, BLUE);
     tft.fillRoundRect(175, 210, 3, 13, 1, BLUE);
}

void drawModerateRain()
{
     tft.drawBitmap(95,140,cloud,128,90,GREY);
     tft.fillRoundRect(144, 210, 3, 15, 1, BLUE);
     tft.fillRoundRect(152, 207, 3, 15, 1, BLUE);
     tft.fillRoundRect(160, 210, 3, 15, 1, BLUE);
     tft.fillRoundRect(168, 207, 3, 15, 1, BLUE);
     tft.fillRoundRect(176, 210, 3, 15, 1, BLUE);
}

void drawHeavyRain()
{
     tft.drawBitmap(95,140,cloud,128,90,GREY);
     tft.fillRoundRect(136, 207, 3, 15, 1, BLUE);
     tft.fillRoundRect(144, 210, 3, 15, 1, BLUE);
     tft.fillRoundRect(152, 207, 3, 15, 1, BLUE);
     tft.fillRoundRect(160, 210, 3, 15, 1, BLUE);
     tft.fillRoundRect(168, 207, 3, 15, 1, BLUE);
     tft.fillRoundRect(176, 210, 3, 15, 1, BLUE);
     tft.fillRoundRect(184, 207, 3, 15, 1, BLUE);
}

void drawThunderstorm()
{
     tft.drawBitmap(95,145,thunder,128,90,YELLOW);
     tft.drawBitmap(95,140,cloud,128,90,GREY);//0  35
     tft.fillRoundRect(144, 210, 3, 15, 1, BLUE);
     tft.fillRoundRect(152, 210, 3, 15, 1, BLUE);
     tft.fillRoundRect(168, 210, 3, 15, 1, BLUE);
     tft.fillRoundRect(176, 210, 3, 15, 1, BLUE);
}

void drawLightSnowfall()
{
     tft.drawBitmap(0,35,cloud,128,90,GREY);
     tft.fillCircle(50, 105, 3, GREY);
     tft.fillCircle(65, 108, 3, GREY);
     tft.fillCircle(82, 105, 3, GREY);
}

void drawModerateSnowfall()
{
     tft.drawBitmap(0,35,cloud,128,90,GREY);
     tft.fillCircle(50, 105, 3, GREY);
     tft.fillCircle(50, 115, 3, GREY);
     tft.fillCircle(65, 108, 3, GREY);
     tft.fillCircle(65, 118, 3, GREY);
     tft.fillCircle(82, 105, 3, GREY);
     tft.fillCircle(82, 115, 3, GREY);
}

void drawHeavySnowfall()
{
     tft.drawBitmap(0,35,cloud,128,90,GREY);
     tft.fillCircle(40, 105, 3, GREY);
     tft.fillCircle(52, 105, 3, GREY);
     tft.fillCircle(52, 115, 3, GREY);
     tft.fillCircle(65, 108, 3, GREY);
     tft.fillCircle(65, 118, 3, GREY);
     tft.fillCircle(80, 105, 3, GREY);
     tft.fillCircle(80, 115, 3, GREY);
     tft.fillCircle(92, 105, 3, GREY);     
}

void drawCloudSunAndRain()
{
     tft.fillCircle(73,70,20,YELLOW);
     tft.drawBitmap(0,32,cloud,128,90,BLACK);
     tft.drawBitmap(0,35,cloud,128,90,GREY);
     tft.fillRoundRect(50, 105, 3, 13, 1, BLUE);
     tft.fillRoundRect(65, 105, 3, 13, 1, BLUE);
     tft.fillRoundRect(80, 105, 3, 13, 1, BLUE);
}

void drawCloudAndTheMoon()
{
     tft.fillCircle(94,60,18,GREY);
     tft.fillCircle(105,53,18,BLACK);
     tft.drawBitmap(0,32,cloud,128,90,BLACK);
     tft.drawBitmap(0,35,cloud,128,90,GREY);
}

void drawCloudTheMoonAndRain()
{
     tft.fillCircle(94,60,18,GREY);
     tft.fillCircle(105,53,18,BLACK);
     tft.drawBitmap(0,32,cloud,128,90,BLACK);
     tft.drawBitmap(0,35,cloud,128,90,GREY);
     tft.fillRoundRect(50, 105, 3, 13, 1, BLUE);
     tft.fillRoundRect(65, 105, 3, 13, 1, BLUE);
     tft.fillRoundRect(80, 105, 3, 13, 1, BLUE);
}

//void drawWind()
//{  
//     tft.drawBitmap(0,35,wind,128,90,GREY);   
//}

//void drawFog()
//{
//  tft.fillRoundRect(45, 60, 40, 4, 1, GREY);
//  tft.fillRoundRect(40, 70, 50, 4, 1, GREY);
//  tft.fillRoundRect(35, 80, 60, 4, 1, GREY);
//  tft.fillRoundRect(40, 90, 50, 4, 1, GREY);
//  tft.fillRoundRect(45, 100, 40, 4, 1, GREY);
//}

void clearText()
{
     tft.fillRect(130,70,177,38,BLACK);
}

void clearIco()
{
     tft.fillRect(60,160,200,80,BLACK);
}

void control()
{

      if(t<90 && t>-40) temperature=t;
      if(h<101 && h>0) humidity=h;
      if(p>0 && p<1025) pioggia=p;
      if(c>0) co=c;


}
